## sources/kernel/stereolabs/drivers/Kconfig
```kconfig
append_menu "Device Drivers"

if ARCH_TEGRA
source "drivers/stereolabs/Kconfig"
endif

endmenu
```

## sources/kernel/stereolabs/drivers/stereolabs/bmi088/Kconfig
```kconfig
config SL_IMU_BMI088
	tristate "BMI088 IMU support"
	depends on I2C
	help
	  This enables support for the Bosch BMI088 IMU sensor.
	  The driver communicates over I2C and registers as a virtual device.

	  To compile this driver as a module, choose M here: the module
	  will be called bmi088.
```

## sources/kernel/stereolabs/drivers/stereolabs/max9296/Kconfig
```kconfig
config SL_DESER_MAX9296
	tristate "Stereolabs MAX9296 Deserializer"
	help
	  If you say yes here you get support for the MAX9296 deserializer.

	  To compile this driver as a module, choose M here: the module
	  will be called max9296.

config TEGRA_STREAMERBOX_ADDR_FIX
	tristate "Stereolabs option for StreamerBox"
	depends on SL_DESER_MAX9296
	help
		If you wish to compile for L4T R32.7, please check this option.
```

## src/kernel/stereolabs/drivers/stereolabs/max96724/Kconfig
```kconfig
config SL_DESER_MAX96724

	tristate "Stereolabs MAX96724 Deserializer"
	help
	  If you say yes here you get support for the MAX96724 deserializer.

	  To compile this driver as a module, choose M here: the module
	  will be called max96724.
```

## src/kernel/stereolabs/drivers/stereolabs/zedone4k/Kconfig
```kconfig
config SL_VIDEO_ZEDONE4K
	tristate "ZED-4K IMX678 prototype camera sensor support"
	depends on I2C && VIDEO_V4L2 && VIDEO_V4L2_SUBDEV_API && ( SL_DESER_MAX96712 || SL_DESER_MAX96724 || SL_DESER_MAX9296 )
	help
	  This is a Video4Linux2 sensor-level driver for Stereolabs ZED-One 4K
	  prototype camera.

	  To compile this driver as a module, choose M here: the module
	  will be called imx678.ko and will be compile with max929x.ko.
```
